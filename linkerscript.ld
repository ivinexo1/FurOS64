OUTPUT_FORMAT(binary)
ENTRY(kernel)
SECTIONS
{
  .text.start (0xffff800000000000):{}
  .text : ALIGN(CONSTANT(MAXPAGESIZE)) {}

  .data : ALIGN(CONSTANT(MAXPAGESIZE)) {}

  .bss : ALIGN(CONSTANT(MAXPAGESIZE)) {}
}
